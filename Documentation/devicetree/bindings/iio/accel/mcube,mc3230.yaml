## Documentation/devicetree/bindings/iio/accel/mcube,mc3230.yaml
```yaml
# SPDX-License-Identifier: (GPL-2.0 OR BSD-2-Clause)
%YAML 1.2
---
$id: http://devicetree.org/schemas/iio/accel/mcube,mc3230.yaml#
$schema: http://devicetree.org/meta-schemas/core.yaml#

title: mCube MC3230 and compatible 3-axis accelerometers

maintainers:
  - Hans de Goede <hdegoede@redhat.com>

description:
  The MC3230 and MC3510C report each axis as a signed 8-bit value; the MC3416
  reports 16-bit little-endian samples instead.  All three answer on the same
  fixed 7-bit I2C address, 0x4c.

properties:
  compatible:
    enum:
      - mcube,mc3230
      - mcube,mc3416
      - mcube,mc3510c

  reg:
    maxItems: 1

  mount-matrix:
    description: an optional 3x3 mounting rotation matrix.

required:
  - compatible
  - reg

additionalProperties: false

examples:
  - |
    i2c {
        #address-cells = <1>;
        #size-cells = <0>;

        accelerometer@4c {
            compatible = "mcube,mc3230";
            reg = <0x4c>;
            mount-matrix = "0", "1", "0",
                           "1", "0", "0",
                           "0", "0", "1";
        };
    };
...
```

## Documentation/devicetree/bindings/iio/light/mediatek,mn29xxxals.yaml
```yaml
# SPDX-License-Identifier: (GPL-2.0-only OR BSD-2-Clause)
%YAML 1.2
---
$id: http://devicetree.org/schemas/iio/light/mediatek,mn29xxxals.yaml#
$schema: http://devicetree.org/meta-schemas/core.yaml#

title: MN29005 ambient light sensor using the MediaTek MN29 protocol

maintainers:
  - Sean Qureshi <2031258+stqism@users.noreply.github.com>

description: |
  Ambient light support for the MN29005 protocol with revision 0x1288.
  The compatible follows the public MediaTek MN29 ALS driver. It does not
  imply support for every MN29-family part. The host must have exclusive
  ownership of the I2C bus; a sensor hub must not access the same device.
  This binding describes polling ambient light operation only. Proximity
  emission and interrupts are not enabled.

properties:
  compatible:
    const: mediatek,mn29xxxals

  reg:
    items:
      - const: 0x49

required:
  - compatible
  - reg

additionalProperties: false

examples:
  - |
    i2c {
        #address-cells = <1>;
        #size-cells = <0>;

        light-sensor@49 {
            compatible = "mediatek,mn29xxxals";
            reg = <0x49>;
        };
    };
```

## Documentation/devicetree/bindings/input/touchscreen/tchip,ilitek.yaml
```yaml
# SPDX-License-Identifier: (GPL-2.0-only OR BSD-2-Clause)
%YAML 1.2
---
$id: http://devicetree.org/schemas/input/touchscreen/tchip,ilitek.yaml#
$schema: http://devicetree.org/meta-schemas/core.yaml#

title: Ilitek ILI2xxx I2C touchscreen controller

maintainers:
  - Denys Vitali <denys@denv.it>

description: |
  Ilitek I2C touchscreen controllers driven by
  drivers/input/touchscreen/ilitek_ts_i2c.c.

  NOTE: the "tchip,ilitek" compatible is a downstream (jagar) addition to
  that driver, not an upstream of_match entry.  It was added together with a
  vendor-reset quirk keyed off exactly this string, so substituting a real
  "ilitek,ili2xxx" compatible would silently change the reset sequence this
  panel expects.  This binding exists only to silence dtbs_check on the
  downstream branch; upstream should instead identify the part and use a real
  ilitek compatible, moving the reset sequence into a device-specific quirk.

properties:
  compatible:
    const: tchip,ilitek

  reg:
    maxItems: 1

  interrupts:
    maxItems: 1

  reset-gpios:
    maxItems: 1

  vdd-supply:
    description: Power supply regulator for the touchscreen controller

required:
  - compatible
  - reg

allOf:
  - $ref: touchscreen.yaml

unevaluatedProperties: false

examples:
  - |
    i2c {
        #address-cells = <1>;
        #size-cells = <0>;

        touchscreen@41 {
            compatible = "tchip,ilitek";
            reg = <0x41>;
            interrupt-parent = <&pio>;
            interrupts = <12 IRQ_TYPE_EDGE_FALLING>;
            reset-gpios = <&pio 40 GPIO_ACTIVE_HIGH>;
            vdd-supply = <&reg_vctp_3v3>;
        };
    };
```

## Documentation/devicetree/bindings/input/touchscreen/wacom,wacom-i2c.yaml
```yaml
# SPDX-License-Identifier: (GPL-2.0-only OR BSD-2-Clause)
%YAML 1.2
---
$id: http://devicetree.org/schemas/input/touchscreen/wacom,wacom-i2c.yaml#
$schema: http://devicetree.org/meta-schemas/core.yaml#

title: Wacom EMR pen digitizer connected via I2C

maintainers:
  - Tatsunosuke Tobita <tobita.tatsunosuke@wacom.co.jp>

description: |
  Wacom EMR (electro-magnetic resonance) pen digitizers that speak the
  register/feature-report protocol handled by drivers/input/touchscreen/
  wacom_i2c.c: commands are written to register 0x0004 and coordinate
  frames are read as 19 plain bytes on the data register.

  Not all firmwares answer the feature query even though they stream
  coordinates; where the query fails, the axis limits come from the
  common touchscreen properties instead.

allOf:
  - $ref: touchscreen.yaml#

properties:
  compatible:
    const: wacom,wacom-i2c

  reg:
    maxItems: 1

  interrupts:
    maxItems: 1

  vdd-supply:
    description: Core digital supply of the digitizer.

  reset-gpios:
    maxItems: 1

  wacom,no-barrel-switch2:
    type: boolean
    description:
      The second barrel switch (data[3] bit 4) is not usable on this
      board: the firmware holds the bit set for every in-proximity
      frame.  When present the driver neither reports BTN_STYLUS2 nor
      advertises the capability.

  wacom,visible-x-min:
    $ref: /schemas/types.yaml#/definitions/uint32
    description: See wacom,visible-y-max.

  wacom,visible-x-max:
    $ref: /schemas/types.yaml#/definitions/uint32
    description: See wacom,visible-y-max.

  wacom,visible-y-min:
    $ref: /schemas/types.yaml#/definitions/uint32
    description: See wacom,visible-y-max.

  wacom,visible-y-max:
    $ref: /schemas/types.yaml#/definitions/uint32
    description: |
      Visible-area window in hardware frame coordinates (before any
      touchscreen-inverted-* mapping is applied).  Some panels keep
      reporting a millimetre or two past the visible glass on every
      side; when all four values are given the driver remaps the window
      onto the full reported axis range so userspace receives exactly
      the visible area.  Coordinates outside the window clamp to the
      edges.  All four properties are required for the remap to apply;
      otherwise it is ignored.

required:
  - compatible
  - reg
  - interrupts

unevaluatedProperties: false

examples:
  - |
    #include <dt-bindings/gpio/gpio.h>
    #include <dt-bindings/interrupt-controller/irq.h>

    i2c {
        #address-cells = <1>;
        #size-cells = <0>;

        digitizer@9 {
            compatible = "wacom,wacom-i2c";
            reg = <0x09>;
            interrupt-parent = <&pio>;
            interrupts = <9 IRQ_TYPE_LEVEL_LOW>;
            reset-gpios = <&pio 88 GPIO_ACTIVE_LOW>;
            vdd-supply = <&reg_1v8>;
            touchscreen-size-x = <16320>;
            touchscreen-size-y = <21120>;
        };
    };
```

## Documentation/devicetree/bindings/power/supply/mediatek,mt6375.yaml
```yaml
# SPDX-License-Identifier: (GPL-2.0-only OR BSD-2-Clause)
%YAML 1.2
---
$id: http://devicetree.org/schemas/power/supply/mediatek,mt6375.yaml#
$schema: http://devicetree.org/meta-schemas/core.yaml#

title: MediaTek MT6375 read-only charger telemetry

maintainers:
  - Denys Vitali <denys@denv.it>

description: |
  Binding for the MediaTek MT6375 PMU I2C bank as consumed by the Daylight
  DC-1 (jagar) read-only charger telemetry driver,
  drivers/power/supply/mt6375-charger-readonly.c.

  This binding is specific to that driver.  The MT6375 is a multi-address
  device whose PMU bank sits at 0x34 with the charger registers at offsets
  0x20..0xe1, but the driver only reports the charger configuration the
  bootloader left behind and cannot change it (its regmap writeable_reg
  returns false unconditionally).  The binding therefore carries no
  properties beyond the I2C reg.

  The MT6375 Type-C/PD controller, ADC, and backlight banks are deliberately
  not described here, and the part is not register-compatible with the MT6360
  or MT6370 devices that do have mainline bindings, so theirs must not be
  borrowed for it.

properties:
  compatible:
    const: mediatek,mt6375

  reg:
    maxItems: 1

required:
  - compatible
  - reg

additionalProperties: false

examples:
  - |
    i2c {
        #address-cells = <1>;
        #size-cells = <0>;

        pmic@34 {
            compatible = "mediatek,mt6375";
            reg = <0x34>;
        };
    };
```

## drivers/pmdomain/mediatek/Kconfig
```kconfig
# SPDX-License-Identifier: GPL-2.0-only

menu "MediaTek PM Domains"
	depends on ARCH_MEDIATEK || COMPILE_TEST

config MTK_SCPSYS
	bool "MediaTek SCPSYS Support"
	default ARCH_MEDIATEK
	depends on OF
	select REGMAP
	select MTK_INFRACFG
	select PM_GENERIC_DOMAINS if PM
	help
	  Say yes here to add support for the MediaTek SCPSYS power domain
	  driver.

config MTK_SCPSYS_PM_DOMAINS
	bool "MediaTek SCPSYS generic power domain"
	default ARCH_MEDIATEK
	depends on PM
	select PM_GENERIC_DOMAINS
	select REGMAP
	help
	  Say y here to enable power domain support.
	  In order to meet high performance and low power requirements, the System
	  Control Processor System (SCPSYS) has several power management related
	  tasks in the system.

config MTK_MT6789_LIVE_GPU_OVERLAY
	tristate "MT6789 shipped-DT GPU overlay loader"
	depends on MTK_SCPSYS_PM_DOMAINS
	depends on OF_OVERLAY
	depends on FW_LOADER
	depends on REGULATOR
	depends on CRYPTO_SHA256
	help
	  Build the opt-in Daylight DC-1 loader for the exact, separately
	  packaged MT6789 live-DT GPU overlay.  The production firmware passes a
	  legacy flat power-domain node, so the overlay adds a second, nested
	  provider containing only MFG0 through MFG3 before Panfrost is loaded.

	  This is a one-shot bring-up module: after validating the cold-boot DT
	  and overlay identity, it fixes and enables both GPU rails, instantiates
	  the nested power controller, and retains those resources until reboot.
	  It deliberately has no module exit path.  Say N on other MT6789 boards.

config MTK_MFG_PM_DOMAIN
	bool "MediaTek MFlexGraphics power domain"
	default ARCH_MEDIATEK
	depends on PM
	depends on OF
	depends on COMMON_CLK
	select MAILBOX
	select PM_GENERIC_DOMAINS
	imply MTK_GPUEB_MBOX
	help
	  Say y or m here to enable the power domains driver for MediaTek
	  MFlexGraphics. This driver allows for power and frequency control of
	  GPUs on MediaTek SoCs such as the MT8196 or MT6991.

	  This driver is required for the Mali GPU to work at all on MT8196 and
	  MT6991.

config AIROHA_CPU_PM_DOMAIN
	tristate "Airoha CPU power domain"
	default ARCH_AIROHA
	depends on HAVE_ARM_SMCCC
	depends on PM
	select PM_GENERIC_DOMAINS
	help
	  Say y here to enable CPU power domain support for Airoha SoC.

	  CPU frequency and power is controlled by ATF with SMC command to
	  set performance states.

endmenu
```
